## CMakeLists.txt
```
cmake_minimum_required(VERSION 3.8.2)
include($ENV{ZEPHYR_BASE}/cmake/app/boilerplate.cmake NO_POLICY_SCOPE)
project(esp_firmware)

# The project version number.
set(VERSION_MAJOR   0   CACHE STRING "Project major version number.")
set(VERSION_MINOR   0   CACHE STRING "Project minor version number.")
set(VERSION_PATCH   1   CACHE STRING "Project patch version number.")
mark_as_advanced(VERSION_MAJOR VERSION_MINOR VERSION_PATCH)

FILE(GLOB app_sources src/*.c)
target_sources(app PRIVATE ${app_sources})

#
# Generate a .h file for each static file
#
foreach(inc_file
        index.html
        root.xml
        404.html)
    generate_inc_file_for_target(
        app
        fsdata/${inc_file}
        ${ZEPHYR_BINARY_DIR}/include/generated/${inc_file}.inc
    )
endforeach()

# first we can indicate the documentation build as an option and set it to ON by default
option(BUILD_DOC "Build documentation" ON)

# check if Doxygen is installed
find_package(Doxygen)
if (DOXYGEN_FOUND)
    # set input and output files
    set(DOXYGEN_IN ${CMAKE_CURRENT_SOURCE_DIR}/Doxyfile.in)
    set(DOXYGEN_OUT ${CMAKE_CURRENT_BINARY_DIR}/Doxyfile)

    # request to configure the file
    configure_file(${DOXYGEN_IN} ${DOXYGEN_OUT} @ONLY)
    message("Doxygen build started")

    # note the option ALL which allows to build the docs together with the application
    add_custom_target( doc_doxygen ALL
            COMMAND ${DOXYGEN_EXECUTABLE} ${DOXYGEN_OUT}
            WORKING_DIRECTORY ${CMAKE_CURRENT_BINARY_DIR}
            COMMENT "Generating API documentation with Doxygen"
            VERBATIM )
else (DOXYGEN_FOUND)
    message("Doxygen need to be installed to generate the doxygen documentation")
endif (DOXYGEN_FOUND)
```

## prj.conf
```kconfig
CONFIG_NETWORKING=y
CONFIG_NET_TCP=y
CONFIG_ENTROPY_GENERATOR=y
CONFIG_TEST_RANDOM_GENERATOR=y
CONFIG_NET_LOG=y
#CONFIG_LOG=y
CONFIG_INIT_STACKS=y

CONFIG_NET_PKT_RX_COUNT=32
CONFIG_NET_PKT_TX_COUNT=32
CONFIG_NET_BUF_RX_COUNT=32
CONFIG_NET_BUF_TX_COUNT=32

#CONFIG_NET_IF_UNICAST_IPV6_ADDR_COUNT=2
#CONFIG_NET_IF_MCAST_IPV6_ADDR_COUNT=4

CONFIG_NET_MAX_CONTEXTS=16

CONFIG_HTTP=y
CONFIG_HTTP_SERVER=y
# Allow two concurrent connections
CONFIG_NET_TCP_BACKLOG_SIZE=5
CONFIG_NET_APP_SERVER_NUM_CONN=5

CONFIG_NET_IPV6=n
CONFIG_NET_IPV4=y
CONFIG_NET_DHCPV4=y

CONFIG_HTTPS=n
CONFIG_MBEDTLS=n

#CONFIG_NET_CONFIG_SETTINGS=y
#CONFIG_NET_CONFIG_MY_IPV6_ADDR="2001:db8::1"
#CONFIG_NET_CONFIG_MY_IPV4_ADDR="192.0.2.1"

CONFIG_NET_CONFIG_NEED_IPV6=n
CONFIG_NET_CONFIG_NEED_IPV4=y

CONFIG_NET_SHELL=y
CONFIG_NET_STATISTICS=y

CONFIG_NET_MGMT=y
CONFIG_NET_MGMT_EVENT=y

CONFIG_SYS_LOG=y
CONFIG_SYS_LOG_SHOW_TAGS=y
CONFIG_SYS_LOG_SHOW_COLOR=y
CONFIG_SYS_LOG_DEFAULT_LEVEL=4
CONFIG_LOG=y
CONFIG_LOG_BACKEND_NATIVE_POSIX=y
CONFIG_LOG_INPLACE_PROCESS=y

#
# C++ Options
#
#CONFIG_CPLUSPLUS=y
#CONFIG_STD_CPP11=n
#CONFIG_STD_CPP17=y

#
# Link layer options
#
CONFIG_NET_ARP=y
CONFIG_NET_ARP_TABLE_SIZE=5

#
# Networking
#
#CONFIG_NETWORKING=y
CONFIG_NET_HOSTNAME_ENABLE=y
CONFIG_NET_HOSTNAME="zephyr"
CONFIG_NET_SOCKETS=y

HEAP_MEM_POOL_SIZE=1024
```

## src/main.c
```c
/**
 * @file main.c
 *
 * @brief Main program entry point
 * @author David Suárez
 * @date Mon, 17 Dec 2018 13:36:48 +0100
 *
 * Copyright (c) 2018 David Suárez.
 * Email: david.sephirot@gmail.com
 *
 * This file is part of upnp-control.
 *
 * upnp-control is free software: you can redistribute it and/or modify
 * it under the terms of the GNU General Public License as published by
 * the Free Software Foundation, either version 3 of the License, or
 * (at your option) any later version.
 *
 * upnp-control is distributed in the hope that it will be useful,
 * but WITHOUT ANY WARRANTY; without even the implied warranty of
 * MERCHANTABILITY or FITNESS FOR A PARTICULAR PURPOSE.  See the
 * GNU General Public License for more details.
 *
 * You should have received a copy of the GNU General Public License
 * along with upnp-control.  If not, see <http://www.gnu.org/licenses/>.
 *
 */

#define LOG_MODULE_NAME main
#include <logging/log.h>
LOG_MODULE_REGISTER(LOG_MODULE_NAME, LOG_LEVEL_DBG);

#define CONFIG_NET_DHCPV4 // XXX: remove
#define  CONFIG_NET_IPV4

#include <zephyr.h>
#include <net/net_if.h>

#include "network.h"
#include "upnp.h"


void panic(const char *msg)
{
    if (msg) {
        LOG_ERR("%s", msg);
    }

    for (;;) {
        k_sleep(K_FOREVER);
    }
}

void main(void)
{
    int ret;
    struct net_if *iface = NULL;

    iface = net_if_get_first_by_type(&NET_L2_GET_NAME(ETHERNET));

    if (iface == NULL) {
        panic("No existe ninguna interfaz de red");
    }

    ret = wait_for_net_interface_up(iface);

    if (ret != 0) {
        panic(NULL);
    }

    /*
     * Get the first ip unicast address configured in the interface as the upnp server address
     */
    ret = init_upnp_system(&iface->config.ip.ipv4->unicast[0].address);

    if (ret != 0) {
        panic(NULL);
    }

    LOG_INF("exiting");
}
```

## src/httpd.c
```c
/**
 * @file httpd.c
 *
 * @brief HTTP server
 * @author David Suárez
 * @date Mon, 17 Dec 2018 13:36:48 +0100
 *
 * Copyright (c) 2018 David Suárez.
 * Email: david.sephirot@gmail.com
 *
 * This file is part of upnp-control.
 *
 * upnp-control is free software: you can redistribute it and/or modify
 * it under the terms of the GNU General Public License as published by
 * the Free Software Foundation, either version 3 of the License, or
 * (at your option) any later version.
 *
 * upnp-control is distributed in the hope that it will be useful,
 * but WITHOUT ANY WARRANTY; without even the implied warranty of
 * MERCHANTABILITY or FITNESS FOR A PARTICULAR PURPOSE.  See the
 * GNU General Public License for more details.
 *
 * You should have received a copy of the GNU General Public License
 * along with upnp-control.  If not, see <http://www.gnu.org/licenses/>.
 *
 */

#include <stdio.h>

#define LOG_MODULE_NAME httpd
#include <logging/log.h>
LOG_MODULE_REGISTER(LOG_MODULE_NAME, LOG_LEVEL_DBG);

#include <zephyr.h>
#include <net/net_context.h>
#include <net/http.h>

#include "httpd.h"

/*
 * NOTE: the http_server_ctx and http_server_urls are quite large (avoid allocate from stack).
 */
static struct http_ctx http_ctx;
static struct http_server_urls http_urls;

#define RESULT_BUF_SIZE 1500
static u8_t http_result[RESULT_BUF_SIZE];

#define HTML_HEADER		"<html><head>" \
				"<title>Zephyr HTTP Server</title>" \
				"</head><body><h1>" \
				"<center>Zephyr HTTP server</center></h1>\r\n"

#define HTTP_STATUS_200_OK	"HTTP/1.1 200 OK\r\n" \
				"Content-Type: text/html\r\n" \
				"Transfer-Encoding: chunked\r\n"

#define HTTP_STATUS_404	"HTTP/1.1 404 Not Found\r\n" \
				"Content-Type: text/html\r\n" \
				"Transfer-Encoding: chunked\r\n"


static const char *get_string(int str_len, const char *str)
{
    static char buf[64];
    int len = min(str_len, sizeof(buf) - 1);

    memcpy(buf, str, len);
    buf[len] = '\0';

    return buf;
}

static int http_response(struct http_ctx *ctx, const char *header, const char *payload, size_t payload_len,
                         char *str, const struct sockaddr *dst)
{
    int ret;

    ret = http_add_header(ctx, header, dst, str);

    if (ret < 0) {
        LOG_ERR("Cannot add HTTP header (%d)", ret);
        return ret;
    }

    ret = http_add_header(ctx, HTTP_CRLF, dst, str);

    if (ret < 0) {
        LOG_ERR("Cannot send data to peer (%d)", ret);
        return ret;
    }

    ret = http_send_chunk(ctx, payload, payload_len, dst, str);

    if (ret < 0) {
        LOG_ERR("Cannot send data to peer (%d)", ret);
        return ret;
    }

    ret = http_send_chunk(ctx, NULL, 0, dst, NULL);

    if (ret < 0) {
        LOG_ERR("Cannot send data to peer (%d)", ret);
        return ret;
    }

    return http_send_flush(ctx, str);
}

static int http_serve_index_html(struct http_ctx *ctx, const struct sockaddr *dst)
{
    static const char index_html[] = {
#include "index.html.inc"
    };

    LOG_DBG("Sending index.html (%zd bytes) to client", sizeof(index_html));

    return http_response(ctx, HTTP_STATUS_200_OK, index_html, sizeof(index_html), "Index", dst);
}

static int http_response_soft_404(struct http_ctx *ctx, const struct sockaddr *dst)
{
    static const char not_found[] = {
#include "404.html.inc"
    };

    LOG_DBG("Sending 404.html (%zd bytes) to client", sizeof(not_found));

    return http_response(ctx, HTTP_STATUS_404, not_found, sizeof(not_found), "404", dst);
}


static enum http_verdict default_handler(struct http_ctx *ctx, enum http_connection_type type,
                                                               const struct sockaddr *dst)
{
    LOG_DBG("No handler for %s URL %s",
            type == HTTP_CONNECTION ? "HTTP" : "WS",
            get_string(ctx->http.url_len, ctx->http.url));

    if (type == HTTP_CONNECTION) {
        http_response_soft_404(ctx, dst);
    }

    return HTTP_VERDICT_DROP;
}

static void http_connected(struct http_ctx *ctx, enum http_connection_type type,
                           const struct sockaddr *dst, void *user_data)
{
    char url[32];
    int len = min(sizeof(url) - 1, ctx->http.url_len);

    memcpy(url, ctx->http.url, len);
    url[len] = '\0';

    LOG_DBG("%s connect attempt URL %s",
            type == HTTP_CONNECTION ? "HTTP" : "WS", url);

    if (type == HTTP_CONNECTION) {
        if (strncmp(ctx->http.url, "/",
                    ctx->http.url_len) == 0) {
            http_serve_index_html(ctx, dst);
            http_close(ctx);
            return;
        }

        if (strncmp(ctx->http.url, "/index.html",
                    ctx->http.url_len) == 0) {
            http_serve_index_html(ctx, dst);
            http_close(ctx);
            return;
        }
    }

    /* Give 404 error for all the other URLs we do not want to handle
     * right now.
     */
    http_response_soft_404(ctx, dst);
    http_close(ctx);
}

static void http_received(struct http_ctx *ctx, struct net_pkt *pkt, int status, u32_t flags,
                          const struct sockaddr *dst, void *user_data)
{
    if (!status) {
        if (pkt) {
            LOG_DBG("Received %d bytes data",
                    net_pkt_appdatalen(pkt));
            net_pkt_unref(pkt);
        }
    } else {
        LOG_ERR("Receive error (%d)", status);

        if (pkt) {
            net_pkt_unref(pkt);
        }
    }
}

static void http_sent(struct http_ctx *ctx, int status, void *user_data_send, void *user_data)
{
    LOG_DBG("%s sent", (char *)user_data_send);
}

static void http_closed(struct http_ctx *ctx, int status, void *user_data)
{
    LOG_DBG("Connection %p closed", ctx);
}

int httpd_init()
{
    struct sockaddr addr, *server_addr;
    int ret;

    LOG_INF("initializating HTTP server");

    (void) memset(&addr, 0, sizeof(addr));

    net_sin(&addr)->sin_port = htons(80); //htons(ZEPHYR_PORT);

    /* listen only IPv4 */
    addr.sa_family = AF_INET; //family = AF_INET;

    server_addr = &addr;

    http_server_add_default(&http_urls, default_handler);
    http_server_add_url(&http_urls, "/index.html", HTTP_URL_STANDARD);
    http_server_add_url(&http_urls, "/", HTTP_URL_STANDARD);

    ret = http_server_init(&http_ctx, &http_urls, server_addr, http_result,
                           sizeof(http_result), "Zephyr HTTP Server",
                           NULL);
    if (ret < 0) {
        LOG_ERR("Cannot initialize HTTP server (%d)", ret);

        return 1;
    }

#if defined(CONFIG_NET_CONTEXT_NET_PKT_POOL)
    net_app_set_net_pkt_pool(&http_ctx.app_ctx, tx_slab, data_pool);
#endif

    http_set_cb(&http_ctx, http_connected, http_received, http_sent, http_closed);

    /*
     * If needed, the HTTP parser callbacks can be set according to
     * applications own needs before enabling the server. In this example
     * we use the default callbacks defined in HTTP server API.
     */
    http_server_enable(&http_ctx);

    return 0;
}
```

## src/httpd.h
```c
/**
 * @file httpd.h
 *
 * @brief HTTP server
 * @author David Suárez
 * @date Mon, 17 Dec 2018 13:36:48 +0100
 *
 * Copyright (c) 2018 David Suárez.
 * Email: david.sephirot@gmail.com
 *
 * This file is part of upnp-control.
 *
 * upnp-control is free software: you can redistribute it and/or modify
 * it under the terms of the GNU General Public License as published by
 * the Free Software Foundation, either version 3 of the License, or
 * (at your option) any later version.
 *
 * upnp-control is distributed in the hope that it will be useful,
 * but WITHOUT ANY WARRANTY; without even the implied warranty of
 * MERCHANTABILITY or FITNESS FOR A PARTICULAR PURPOSE.  See the
 * GNU General Public License for more details.
 *
 * You should have received a copy of the GNU General Public License
 * along with upnp-control.  If not, see <http://www.gnu.org/licenses/>.
 *
 */

#ifndef HTTP_SERVER_HTTPD_H
#define HTTP_SERVER_HTTPD_H

/**
 * Init the http server
 *
 * @return 0 if success; != on error
 */
int httpd_init();

#endif //HTTP_SERVER_HTTPD_H
```

## src/network.c
```c
/**
 * @file network.c
 *
 * @brief Network helpers
 * @author David Suárez
 * @date Mon, 24 Dec 2018 00:43:29 +0100
 *
 * Copyright (c) 2018 David Suárez.
 * Email: david.sephirot@gmail.com
 *
 * This file is part of upnp-control.
 *
 * upnp-control is free software: you can redistribute it and/or modify
 * it under the terms of the GNU General Public License as published by
 * the Free Software Foundation, either version 3 of the License, or
 * (at your option) any later version.
 *
 * upnp-control is distributed in the hope that it will be useful,
 * but WITHOUT ANY WARRANTY; without even the implied warranty of
 * MERCHANTABILITY or FITNESS FOR A PARTICULAR PURPOSE.  See the
 * GNU General Public License for more details.
 *
 * You should have received a copy of the GNU General Public License
 * along with upnp-control.  If not, see <http://www.gnu.org/licenses/>.
 *
 */

#define LOG_MODULE_NAME network
#include <logging/log.h>
LOG_MODULE_REGISTER(LOG_MODULE_NAME, LOG_LEVEL_DBG);

#include <zephyr.h>
#include <stdlib.h>
#include <net/net_if.h>
#include <net/dhcpv4.h>

#include "network.h"

/**
 * Max wait time to get dhcp ack
 */
#define MAX_NET_CONFIGURATION_WAIT_MILISECONDS K_MINUTES(5)

#define WAIT_MILISECONDS_FOR_DHCP_ACK K_SECONDS(1)

const char* format_net_address_ip(struct net_addr *addr)
{
    char *ip_as_string;
    char *ret;

    ip_as_string = k_malloc(NET_IPV4_ADDR_LEN + 1);

    if (ip_as_string == NULL) {
        return NULL;
    }

    ret = net_addr_ntop(addr->family, (const void*) &addr->in_addr, ip_as_string, NET_IPV4_ADDR_LEN + 1);

    if (ret == NULL) {
        k_free(ip_as_string);
    }

    return ret;
}

const char* format_sock_address_ip(struct sockaddr* addr)
{
    char *ip_as_string;
    char *ret;

    ip_as_string = k_malloc(NET_IPV4_ADDR_LEN + 1);

    if (ip_as_string == NULL) {
        return NULL;
    }

    ret = net_addr_ntop(addr->sa_family, (const void *) &net_sin(addr)->sin_addr, ip_as_string, NET_IPV4_ADDR_LEN + 1);

    if (ret == NULL) {
        k_free(ip_as_string);
    }

    return ret;
}

int wait_for_net_interface_up(struct net_if *iface)
{
    int wait_miliseconds = 0;

    /*
     * wait for dhcp to provide us an ip address
     */
    while (iface->config.dhcpv4.state != NET_DHCPV4_BOUND) {

        LOG_INF("waiting interface '%s', to get dhcp lease", iface->if_dev->dev->config->name);

        wait_miliseconds += WAIT_MILISECONDS_FOR_DHCP_ACK;
        k_sleep(WAIT_MILISECONDS_FOR_DHCP_ACK);

        if (wait_miliseconds > MAX_NET_CONFIGURATION_WAIT_MILISECONDS) {
            LOG_ERR("wait time for network configuration has exceed the maximum allowed");

            return -1;
        }
    }

    return 0;
}
```

## src/network.h
```c
/**
 * @file network.h
 *
 * @brief Network helpers
 * @author David Suárez
 * @date Mon, 24 Dec 2018 00:43:29 +0100
 *
 * Copyright (c) 2018 David Suárez.
 * Email: david.sephirot@gmail.com
 *
 * This file is part of upnp-control.
 *
 * upnp-control is free software: you can redistribute it and/or modify
 * it under the terms of the GNU General Public License as published by
 * the Free Software Foundation, either version 3 of the License, or
 * (at your option) any later version.
 *
 * upnp-control is distributed in the hope that it will be useful,
 * but WITHOUT ANY WARRANTY; without even the implied warranty of
 * MERCHANTABILITY or FITNESS FOR A PARTICULAR PURPOSE.  See the
 * GNU General Public License for more details.
 *
 * You should have received a copy of the GNU General Public License
 * along with upnp-control.  If not, see <http://www.gnu.org/licenses/>.
 *
 */
#ifndef ESP_FIRMWARE_NETWORK_H
#define ESP_FIRMWARE_NETWORK_H

#include "net/net_ip.h"

/**
 * Format a net_addr to string
 *
 * @param addr ip address
 *
 * @return pointer to null terminated string or NULL on fail
 */
const char* format_net_address_ip(struct net_addr *addr);

/**
 * Format a sockaddr to string
 *
 * @param addr ip address
 *
 * @return pointer to null terminated string or NULL on fail
 */
const char* format_sock_address_ip(struct sockaddr *addr);

/**
 * Wait fot the network interface to get configured (we wait for dhcp4 bound, atm)
 *
 * @param iface the interface
 *
 * @return 0 on success; !0 if error
 */
int wait_for_net_interface_up(struct net_if *iface);

#endif //ESP_FIRMWARE_NETWORK_H
```

## src/ssdp.c
```c
/**
 * @file ssdp.c
 *
 * @brief Simple Service Discovery Protocol (ssdp)
 * @author David Suárez
 * @date Mon, 17 Dec 2018 13:36:48 +0100
 *
 * Copyright (c) 2018 David Suárez.
 * Email: david.sephirot@gmail.com
 *
 * This file is part of upnp-control.
 *
 * upnp-control is free software: you can redistribute it and/or modify
 * it under the terms of the GNU General Public License as published by
 * the Free Software Foundation, either version 3 of the License, or
 * (at your option) any later version.
 *
 * upnp-control is distributed in the hope that it will be useful,
 * but WITHOUT ANY WARRANTY; without even the implied warranty of
 * MERCHANTABILITY or FITNESS FOR A PARTICULAR PURPOSE.  See the
 * GNU General Public License for more details.
 *
 * You should have received a copy of the GNU General Public License
 * along with upnp-control.  If not, see <http://www.gnu.org/licenses/>.
 *
 */

#define LOG_MODULE_NAME ssdp
#include <logging/log.h>
LOG_MODULE_REGISTER(LOG_MODULE_NAME, LOG_LEVEL_DBG);

#include <errno.h>
#include <stdio.h>
#include <stdlib.h>

#include <zephyr.h>
//#include <net/socket.h>
#include <net/net_pkt.h>
#include <net/net_core.h>
#include <net/net_context.h>
#include <net/udp.h>
#include <net/net_app.h>

#include "network.h"

#include "ssdp.h"



#define SSDP_NOTIFY_NOTIFICATION_SUBTYPE_AVAILABLE_STRING   "ssdp:alive"
#define SSDP_NOTIFY_NOTIFICATION_SUBTYPE_UNAVAILABLE_STRING "ssdp:byebye"
#define SSDP_NOTIFY_NOTIFICATION_SUBTYPE_UPDATE_STRING      "ssdp:update"

/**
 * Timeout for the packets methods
 */
#define PKT_BUF_TIMEOUT K_MSEC(100)

/**
 * UPnP multicast address
 */
#define UPNP_MCAST_GRP  ("239.255.255.250")

/**
 * UPnP multicast port
 */
#define SSDP_MCAST_PORT (1900)

//static int igmp_join(void);

static void udp_received(struct net_app_ctx *ctx, struct net_pkt *pkt, int status, void *user_data);
static void pkt_sent(struct net_app_ctx *ctx, int status, void *user_data_send, void *user_data);
static inline void set_src_addr(sa_family_t family, struct net_pkt *pkt, struct sockaddr *dst_addr);
static int init_udp_server(ssdp_config_t* config, struct sockaddr *server_addr);

/*
 * NOTE: the net_app_ctx is quite large (avoid allocate from stack).
 */
static struct net_app_ctx udp_ctx;






/** Server User Agent */
#define SSDP_SERVER_USER_AGENT "Unspecified, UPnP/2.0, Unspecified"

/** SSDP SP for all devices/services */
#define SSDP_SEARCH_TARGET_ALL         "ssdp:all"

/** SSDP SP for root device only */
#define SSDP_SEARCH_TARGET_ROOT_DEVICE "upnp:rootdevice"



#define SSDP_NOTIFY  \
    "NOTIFY * HTTP/1.1\r\n" \
    "HOST: 239.255.255.250:1900\r\n" \
    "CACHE-CONTROL: max-age=86400\r\n" \
    "LOCATION: http://%s:80/%s\r\n" \
    "NT: %s\r\n" \
    "NTS: %s\r\n" \
    "SERVER: %s\r\n" \
    "USN: %s" \
    "BOOTID.UPNP.ORG: %s\r\n\r\n"

/*
#define SSDP_SEARCH_RESPONSE \
    "HTTP/1.1 200 OK\r\n" \
    "CACHE-CONTROL: max-age=86400\r\n" \
    "DATE: Fri, 15 Apr 2016 04:56:29 GMT\r\n" \
    "EXT:\r\n" \
    "LOCATION: http://%s:80/%s\r\n" \
    "SERVER: %s\r\n" \
    "ST: %s\r\n" \
    "USN: %s\r\n" \
    "BOOTID.UPNP.ORG: %s" \
    "X-User-Agent: nipe\r\n\r\n"
*/
//  "OPT: \"http://schemas.upnp.org/upnp/1/0/\"; ns=01\r\n"
//  01-NLS: b9200ebb-736d-4b93-bf03-835149d13983\r\n"

#define SSDP_SEARCH_RESPONSE \
    "HTTP/1.1 200 OK\r\n" \
    "EXT:\r\n" \
    "CACHE-CONTROL: max-age=86400\r\n" \
    "ST: %s\r\n" \
    "USN: %s\r\n" \
    "LOCATION: %s\r\n" \
    "%s" \
    "\r\n\r\n"

/*    "DATE: Fri, 15 Apr 2016 04:56:29 GMT\r\n" \
    "SERVER: %s\r\n" \
    "BOOTID.UPNP.ORG: %s" \
    "X-User-Agent: nipe\r\n\r\n"*/



/*
int igmp_join(void)
{
    int ret;

    struct sockaddr_in addr4 = {
            .sin_family = AF_INET,
            .sin_port = htons(SSDP_MCAST_PORT),
            .sin_addr = { { { 239, 255, 255, 250 } } },
    };

    struct sockaddr_in addrdd = {
            .sin_family = AF_INET,
            .sin_port = htons(22222)
    };

    struct sockaddr *bind_addr = &addr4;
    struct sockaddr *bind_addrdd = &addrdd;

    char* dd = "M-SEARCH * HTTP/1.1\n"
               "HOST: 239.255.255.250:1900\n"
               "MAN: \"ssdp:discover\"\n"
               "MX: 1\n"
               "ST: ssdp:all\n"
               "";

    int sock = zsock_socket(bind_addrdd->sa_family, SOCK_DGRAM, IPPROTO_UDP);

    if (sock < 0) {
        LOG_ERR("Failed to create UDP socket : %d", errno);
        return -errno;
    }

    if (ret < 0) {
        LOG_ERR("Failed to bind UDP socket: %d", errno);
        ret = -errno;
    }

    ret = zsock_sendto(sock, dd, strlen(dd), 0,
                       &bind_addr, sizeof(addr4));
    if (ret < 0) {
        LOG_ERR("UDP: Failed to send %d", errno);
        ret = -errno;
    }

    LOG_INF("igmp_joinigmp_joinigmp_join");

    return ret;
}*/


static inline void set_src_addr(sa_family_t family, struct net_pkt *pkt, struct sockaddr *dst_addr)
{
    struct net_udp_hdr hdr, *udp_hdr;

    udp_hdr = net_udp_get_hdr(pkt, &hdr);

    if (!udp_hdr) {
        return;
    }

#if defined(CONFIG_NET_IPV6)
    if (family == AF_INET6) {
		net_ipaddr_copy(&net_sin6(dst_addr)->sin6_addr,
				&NET_IPV6_HDR(pkt)->src);
		net_sin6(dst_addr)->sin6_family = AF_INET6;
		net_sin6(dst_addr)->sin6_port = udp_hdr->src_port;
	}
#endif /* CONFIG_NET_IPV6) */

#if defined(CONFIG_NET_IPV4)
    if (family == AF_INET) {
		net_ipaddr_copy(&net_sin(dst_addr)->sin_addr, &NET_IPV4_HDR(pkt)->src);
		net_sin(dst_addr)->sin_family = AF_INET;
		net_sin(dst_addr)->sin_port = udp_hdr->src_port;
	}
#endif /* CONFIG_NET_IPV6) */
}

#define CR                  '\r'
#define LF                  '\n'
#define SPACE               ' '

typedef enum {
    SSDP_HTTP_NOTIFY,
    SSDP_HTTP_SEARCH,
    SSDP_HTTP_UNKNOW
} ssdp_http_method_t;

/**
 * Get the HTTP method from request data.
 *
 * The method is included in the http request line (first line), which has the next format:
 *
 *  - [method-token] [Request-URI] [protocol version] CRLF
 *
 *  Ex: NOTIFY * HTTP/1.1
 *
 * @param data pointer to http data
 * @param len length of data
 *
 * @return ssdp_http_method_t type
 */
static ssdp_http_method_t get_http_method(const char *data, u16_t len)
{
    const char *p = data;
    char ch;
    int ret;

    for (p = data; p != data + len; p++) {
        ch = *p;

        if (ch == SPACE) {
            break;
        }
    }

    /* found something ? */
    if (p == (data + len)) {
        return SSDP_HTTP_UNKNOW;
    }

    ret = memcmp(data, "NOTIFY", p - data);

    if (ret == 0) {
        return SSDP_HTTP_NOTIFY;
    }

    ret = memcmp(data, "M-SEARCH", p - data);

    if (ret == 0) {
        return SSDP_HTTP_SEARCH;
    }

    return SSDP_HTTP_UNKNOW;
}

int skip_after_str(const char *data, u16_t len, int current, const char *str)
{
    const char *p;
    int str_len = strlen(str);
    int found;

    for (p = data + current; p < data + len - str_len; p++) {

        found = memcmp(p, str, str_len);

        if (found == 0) {
            return p + str_len - data;
        }
    }

    return -1;
}

int found_str(const char *data, u16_t len, int current, const char *str)
{
    const char *p = data + current;
    int str_len = strlen(str);
    int found;

    if ((data + str_len) > data + len) {
        return -1;
    }

    found = memcmp(p, str, str_len);

    if (found == 0) {
        return p + str_len - data;
    }

    return 0;
}

char* get_http_header_value(const char *data, u16_t len, const char* header_name)
{
    const char *p = data;
    char ch;
    int ret;
    int is_last_cr = 0;

    int found_idx;

    found_idx = skip_after_str(data, len, 0, "\r\n");

    /* final reached ? */
    if (found_idx < 0) {
        return NULL;
    }

    found_idx = skip_after_str(data, len, found_idx, "\r\n");

    /* final reached ? */
    if (found_idx < 0) {
        return NULL;
    }

    int header_found;

    while (true) {

        header_found = found_str(data, len, found_idx, header_name);

        /* found something ? */
        if (header_found > 0 ) {
            break;

        /* final reached ? */
        } else if (header_found < 0) {
            return NULL;
        }

        found_idx = skip_after_str(data, len, found_idx, "\r\n");

        /* final reached ? */
        if (found_idx < 0) {
            return NULL;
        }
    }

    found_idx = skip_after_str(data, len, header_found, "\r\n");

    /* final reached ? */
    if (found_idx < 0 ) {
        return NULL;
    }

    int header_value_len = found_idx - 2 - header_found;
    char* value;

    value = k_malloc(header_value_len + 1);

    if (value == NULL) {
        return NULL;
    }

    memcpy(value, data + header_found, header_value_len);

    value[header_value_len] = 0;

    return value;
}

static void udp_received(struct net_app_ctx *ctx, struct net_pkt *pkt, int status, void *user_data)
{
    ssdp_config_t* config = (ssdp_config_t*) user_data;
    struct sockaddr src_addr;

    LOG_INF("received %d bytes", net_pkt_appdatalen(pkt));

    if (config->ssdp_search_callback) {

        ssdp_http_method_t ssdp_method = get_http_method(pkt->appdata, pkt->appdatalen);

        if (ssdp_method == SSDP_HTTP_SEARCH) {

            char* st_value = get_http_header_value(pkt->appdata, pkt->appdatalen, "ST:");

            if (st_value == NULL) {
                return;
            }

            set_src_addr(net_pkt_family(pkt), pkt, &src_addr);

            config->ssdp_search_callback(config, &src_addr, st_value);

            k_free(st_value);
        }
    }

    net_pkt_unref(pkt);
}

static void pkt_sent(struct net_app_ctx *ctx, int status, void *user_data_send, void *user_data)
{
    if (!status) {
        LOG_INF("Sent %d bytes", POINTER_TO_UINT(user_data_send));
    }
}

static int init_udp_server(ssdp_config_t* config, struct sockaddr *server_addr)
{
    int ret;

   // ret = net_app_init_udp_server(&udp_ctx, server_addr, 0, config);
    ret = net_app_init_udp_server(&udp_ctx, NULL, SSDP_MCAST_PORT, config);

    if (ret < 0) {
        // TODO: add ip address
        LOG_ERR("Cannot init SSDP service at port '%d'", SSDP_MCAST_PORT);
        return -1;
    }

#if defined(CONFIG_NET_CONTEXT_NET_PKT_POOL)
    net_app_set_net_pkt_pool(&udp, tx_udp_slab, data_udp_pool);
#endif

    ret = net_app_set_cb(&udp_ctx, NULL, udp_received, pkt_sent, NULL);

    if (ret < 0) {
        LOG_ERR("Cannot set callbacks (%d)", ret);
        net_app_release(&udp_ctx);
        return -1;
    }

    net_app_server_enable(&udp_ctx);
    ret = net_app_listen(&udp_ctx);

    if (ret < 0) {
        LOG_ERR("Cannot wait for connections (%d)", ret);
        net_app_release(&udp_ctx);
        return -1;
    }

    return 0;
}

struct net_pkt *build_reply_pkt(struct net_app_ctx *ctx, sa_family_t family /*struct net_pkt *pkt*/, u8_t* data, size_t data_len)
{
    struct net_pkt *reply_pkt;

    reply_pkt = net_app_get_net_pkt(ctx, family, PKT_BUF_TIMEOUT);

    if (!reply_pkt) {
        return NULL;
    }

    NET_ASSERT(net_pkt_family(reply_pkt) == net_pkt_family(pkt));

    net_pkt_set_appdatalen(reply_pkt, data_len);
    net_pkt_append(reply_pkt, data_len, data, PKT_BUF_TIMEOUT);

    return reply_pkt;
}

/*struct net_pkt *build_notify_packet(struct net_app_ctx *ctx, sa_family_t family,
                                    const char* notification_type, const char* notification_subtype, const char* uuid)
{
    char msg[500];
    size_t msg_len;

    snprintf(
            msg,
            sizeof(msg),
            SSDP_NOTIFY,
            location_ip,
            notification_type,
            notification_subtype,
            SSDP_SERVER_USER_AGENT,
            uuid,
            boot_id);

    msg_len = strlen(msg) + 1;


    return build_reply_pkt(ctx, family, msg, msg_len);
}*/



struct net_pkt *build_search_response_packet(struct net_app_ctx *ctx, sa_family_t family,
                                             uri_t st, uri_t usn, uri_t location, const char* extra_headers)
{
    char msg[500];
    size_t msg_len;

    if (extra_headers == NULL) {
        extra_headers = "";
    }

    snprintf(
            msg,
            sizeof(msg),
    SSDP_SEARCH_RESPONSE,
            st,
            usn,
            location,
            extra_headers);

    msg_len = strlen(msg) + 1;


    return build_reply_pkt(ctx, family, msg, msg_len);
}

ssdp_config_t* ssdp_server_init(struct net_addr* net_addr)
{
    ssdp_config_t* config;
    struct sockaddr server_addr;
    int ret;

    config = k_malloc(sizeof(ssdp_config_t));

    if (config == NULL) {
        return NULL;
    }

    config->ssdp_search_callback = NULL;

#if defined(CONFIG_NET_IPV6)
    if (net_addr->family == AF_INET6) {
        net_ipaddr_copy(&net_sin6(&server_addr)->sin6_addr, &net_addr->in6_addr);
		net_sin6(&server_addr)->sin6_family = AF_INET6;
		net_sin6(&server_addr)->sin6_port = SSDP_MCAST_PORT;
	}
#endif /* CONFIG_NET_IPV6) */

#if defined(CONFIG_NET_IPV4)
    if (net_addr->family == AF_INET) {
        net_ipaddr_copy(&net_sin(&server_addr)->sin_addr, &net_addr->in_addr);
        net_sin(&server_addr)->sin_family = AF_INET;
		net_sin(&server_addr)->sin_port = SSDP_MCAST_PORT;
	}
#endif /* CONFIG_NET_IPV4) */

    ret = init_udp_server(config, &server_addr);

    if (ret < 0) {
        free(config);
        return NULL;
    }

    //igmp_join();

    return config;
}

void ssdp_server_close(ssdp_config_t* config)
{
    net_app_release(&udp_ctx);

    free(config);
}

int ssdp_send_search_response(ssdp_config_t* config, struct sockaddr* dst_addr,
                              uri_t st, uri_t usn, uri_t location, const char* extra_headers)
{
    struct net_pkt *reply_pkt;
    socklen_t dst_len;
    u32_t pkt_len;
    int ret;

    if (dst_addr->sa_family == AF_INET6) {
        dst_len = sizeof(struct sockaddr_in6);

    } else {
        dst_len = sizeof(struct sockaddr_in);
    }

    reply_pkt = build_search_response_packet(&udp_ctx, dst_addr->sa_family, st, usn, location, extra_headers);

    if (!reply_pkt) {
        return -1;
    }

    pkt_len = net_pkt_appdatalen(reply_pkt);

    ret = net_app_send_pkt(&udp_ctx, reply_pkt, &dst_addr, dst_len, K_NO_WAIT, UINT_TO_POINTER(pkt_len));

    if (ret < 0) {
        LOG_ERR("cannot send data to peer (%d)", ret);
        net_pkt_unref(reply_pkt);
    }

    return 0;
}

int ssdp_send_advertisement(ssdp_config_t* config, uri_t type, ssdp_notification_subtype_t subtype,
                            uri_t usn, uri_t location, const char* extra_headers)
{

    return 0;
}
```

## src/ssdp.h
```c
/**
 * @file ssdp.h
 *
 * @brief Simple Service Discovery Protocol (ssdp)
 * @author David Suárez
 * @date Mon, 17 Dec 2018 13:36:48 +0100
 *
 * Copyright (c) 2018 David Suárez.
 * Email: david.sephirot@gmail.com
 *
 * This file is part of upnp-control.
 *
 * upnp-control is free software: you can redistribute it and/or modify
 * it under the terms of the GNU General Public License as published by
 * the Free Software Foundation, either version 3 of the License, or
 * (at your option) any later version.
 *
 * upnp-control is distributed in the hope that it will be useful,
 * but WITHOUT ANY WARRANTY; without even the implied warranty of
 * MERCHANTABILITY or FITNESS FOR A PARTICULAR PURPOSE.  See the
 * GNU General Public License for more details.
 *
 * You should have received a copy of the GNU General Public License
 * along with upnp-control.  If not, see <http://www.gnu.org/licenses/>.
 *
 */

#ifndef HTTP_SERVER_SSDP_H
#define HTTP_SERVER_SSDP_H

#include "net/net_ip.h"

/**
 * URI type
 */
typedef const char* uri_t;

/**
 * List of advertisement notifications subtypes
 */
typedef enum  {
    /** device available */
    SSDP_NOTIFY_NOTIFICATION_SUBTYPE_AVAILABLE,

    /** device unavailable */
    SSDP_NOTIFY_NOTIFICATION_SUBTYPE_UNAVAILABLE,

    /** device updated */
    SSDP_NOTIFY_NOTIFICATION_SUBTYPE_UPDATE
} ssdp_notification_subtype_t;

struct ssdp_config_t;

/**
 * Callback called each time a search request is received.
 *
 * @param config SSDP configuration struct
 * @param src_addr source address
 * @param st search target field received on the request
 */
typedef void (* ssdp_search_callback_t)(struct ssdp_config_t* config, struct sockaddr* src_addr, uri_t st);

/**
 * Configuration data for an instance of a SSDP service
 */
typedef struct ssdp_config_t {

    /** search requests callback (@see ssdp_search_callback_t) */
    ssdp_search_callback_t ssdp_search_callback;

} ssdp_config_t;

/**
 * Init the ssdp server on the network address provided
 *
 * @param net_addr network address to listen
 *
 * @return a ssdp_config_t on success; NULL on error
 */
ssdp_config_t* ssdp_server_init(struct net_addr* net_addr);

/**
 * Closes the ssdp server
 *
 * @param config ssdp_config_t pointer
 */
void ssdp_server_close(ssdp_config_t* config);

/**
 * Sends an advertisement message: let interested SSDP clients know of own presence.
 *
 * @param config SSDP configuration struct
 * @param type notification type header: here goes the service type URI
 * @param subtype notification subtype header (@see ssdp_notification_subtype_t): ssdp:alive, ssdp:byebye, ssdp:update
 * @param usn URN (unique service name) for the service
 * @param location service's location URI
 * @param extra_headers extra http headers
 *
 * @return 0 on success; !0 on error
 */
int ssdp_send_advertisement(ssdp_config_t* config, uri_t type, ssdp_notification_subtype_t subtype,
        uri_t usn, uri_t location, const char* extra_headers);

/**
 * Sends a search response message.
 *
 * This should be called, as a reaction on the search target field of the search request,
 * when a SSDP search message is received (@see ssdp_config @see ssdp_search_callback_t).
 *
 * @param config SSDP configuration struct
 * @param dst_addr destination addr
 * @param st search target field: here goes the service type URI
 * @param usn URN (unique service name) for the service
 * @param location service's location URI
 * @param extra_headers extra http headers
 *
 * @return 0 on success; !0 on error
 */
int ssdp_send_search_response(ssdp_config_t* config, struct sockaddr* dst_addr,
        uri_t st, uri_t usn, uri_t location, const char* extra_headers);

#endif //HTTP_SERVER_SSDP_H
```

## src/upnp.c
```c
/**
 * @file upnp.c
 *
 * @brief UPnP handling
 * @author David Suárez
 * @date Mon, 24 Dec 2018 17:46:33 +0100
 *
 * Copyright (c) 2018 David Suárez.
 * Email: david.sephirot@gmail.com
 *
 * This file is part of upnp-control.
 *
 * upnp-control is free software: you can redistribute it and/or modify
 * it under the terms of the GNU General Public License as published by
 * the Free Software Foundation, either version 3 of the License, or
 * (at your option) any later version.
 *
 * upnp-control is distributed in the hope that it will be useful,
 * but WITHOUT ANY WARRANTY; without even the implied warranty of
 * MERCHANTABILITY or FITNESS FOR A PARTICULAR PURPOSE.  See the
 * GNU General Public License for more details.
 *
 * You should have received a copy of the GNU General Public License
 * along with upnp-control.  If not, see <http://www.gnu.org/licenses/>.
 *
 */

#define LOG_MODULE_NAME upnp
#include <logging/log.h>
LOG_MODULE_REGISTER(LOG_MODULE_NAME, LOG_LEVEL_DBG);

#include "network.h"
#include "httpd.h"
#include "ssdp.h"

#include "upnp.h"

/**
 * The music service
 */
t_upnp_service music_service = {
        "urn:schemas-upnp-org:service:RenderingControl:1",  /* URI */
        "music.xml",                                        /* description URI */
        "MusicControl1",                                    /* control URI */
        "MusicRenderingControl1",                           /* event URI */
};

/**
 * Our uPnP root device
 */
t_upnp_device upnp_device = {
        "urn:ojete-org:service:homecontroller:1",           /* URI */
        "uuid:0622707c-da97-4286-deiv-000000000001",        /* UUID */
        "root.xml",                                         /* description URI */
        { &music_service, NULL },                           /* services list */
        NULL,                                               /* Ip address */
        0,                                                  /* boot id */
};

/*
 * On the UPnP protocol, the search requests aren't mapped 1:1 to responses. We should switch ( st ) as follows:
 *
 *   - ssdp:all
 *       Respond 3+2d+k times for a root device with d embedded devices and s embedded services but only
 *       k distinct service types (see clause 1.1.2, “SSDP message header fields” for a definition of each
 *       message to be sent). Field value for ST header field shall be the same as for the NT header field in
 *       NOTIFY messages with ssdp:alive. (See above.)
 *
 *   - upnp:rootdevice
 *       Respond once for root device. Shall be upnp:rootdevice.
 *
 *   - uuid:device-UUID
 *       Respond once for each matching device, root or embedded. Shall be uuid:device-UUID where device-
 *       UUID is specified by the UPnP vendor. See clause 1.1.4, “UUID format and recommended generation
 *       algorithms” for the MANDATORY UUID format.
 *
 *   - urn:schemas-upnp-org:device:deviceType:ver
 *       Respond once for each matching device, root or embedded.Shall be
 *       urn:schemas-upnp-org:device:deviceType:ver where deviceType and ver are defined by UPnP Forum
 *       working committee and ver shall contain the version of the device type contained in the M-SEARCH
 *       request.
 *
 *   - urn:schemas-upnp-org:service:serviceType:ver
 *       Respond once for each matching service type. shall be urn:schemas-upnp-org:service:serviceType:ver
 *       where serviceType and ver are defined by the UPnP
 *       Forum working committee and ver shall contain the version of the service type contained in the M -
 *       SEARCH request.
 *
 *   - urn:domain-name:device:deviceType:ver
 *       Respond once for each matching device, root or embedded. shall be urn:domain-
 *       name:device:deviceType:ver where domain-name (a Vendor Domain Name), deviceType and ver are
 *       defined by the UPnP vendor and ver shall contain the version of the device type from the M-SEARCH
 *       request. Period characters in the Vendor Domain Name shall be replaced with hyphens in accordance
 *       with RFC 2141.
 *
 *   - urn:domain-name:service:serviceType:ver
 *       Respond once for each matching service type. shall be urn: domain-name:service:serviceType:ver
 *       where domain-name (a Vendor Domain Name), serviceType and ver are defined by the UPnP vendor
 *       and ver shall contain the version of the service type from the M-SEARCH request. Period characters
 *       in the Vendor Domain Name shall be replaced with hyphens in accordance with RFC 2141.
 */
void ssdp_search_callback(struct ssdp_config_t* config, struct sockaddr* src_addr, uri_t st)
{

    char* ip = format_sock_address_ip(src_addr);

    LOG_INF("ssdp_search_callback: ip='%s' st='%s'", ip, st);

    k_free(ip);

    ssdp_send_search_response(config, src_addr, st, "usn", "location", "extra_headers");
}

int init_upnp_system(struct net_addr* net_addr)
{
    int ret;
    ssdp_config_t* ssdp_config;

    /* NOTE: this thing should be k_free'd, at some point ... */
    const char* iface_ip = format_net_address_ip(net_addr);

    if (iface_ip == NULL) {
        return -1;
    }

    upnp_device.ip_address = iface_ip;

    /* increment boot counter */
    upnp_device.boot_id++;

    /*
     * Initialize the http and soap transports.
     *
     * This goes prior SSDP initilization, SSDP should knows about the http endpoint for the root device description.
     */
    ret = httpd_init();

    if (ret != 0) {
        return -1;
    }

    /*
     * Initialize the SSDP discovery protocol
     */
    ssdp_config = ssdp_server_init(net_addr);

    if (ssdp_config == NULL) {
        return -1;
    }

    ssdp_config->ssdp_search_callback = ssdp_search_callback;

    return 0;
}
```

## src/upnp.h
```c
/**
 * @file upnp.h
 *
 * @brief UPnP handling
 * @author David Suárez
 * @date Mon, 24 Dec 2018 17:46:33 +0100
 *
 * Copyright (c) 2018 David Suárez.
 * Email: david.sephirot@gmail.com
 *
 * This file is part of upnp-control.
 *
 * upnp-control is free software: you can redistribute it and/or modify
 * it under the terms of the GNU General Public License as published by
 * the Free Software Foundation, either version 3 of the License, or
 * (at your option) any later version.
 *
 * upnp-control is distributed in the hope that it will be useful,
 * but WITHOUT ANY WARRANTY; without even the implied warranty of
 * MERCHANTABILITY or FITNESS FOR A PARTICULAR PURPOSE.  See the
 * GNU General Public License for more details.
 *
 * You should have received a copy of the GNU General Public License
 * along with upnp-control.  If not, see <http://www.gnu.org/licenses/>.
 *
 */

#ifndef ESP_FIRMWARE_UPNP_H
#define ESP_FIRMWARE_UPNP_H

#include "net/net_ip.h"

/**
 * URI type
 */
typedef const char* uri_t;

/**
 * UPnP service info
 */
typedef struct upnp_service {

    /** URI containing the uPnP URN (Uniform Resource Name) */
    uri_t uri;

    /** URL for the service XML descriptor */
    uri_t description_uri;

    /** URL for the service control endpoint */
    uri_t control_uri;

    /** URL for the service event endpoint */
    uri_t event_uri;

} t_upnp_service;

/**
 * UPnP device info
 */
typedef struct upnp_device {

    /** URI containing the uPnP URN (Uniform Resource Name) */
    uri_t uri;

    /** Universally unique ID for this device */
    char* uuid;

    /** URL for the device XML descriptor */
    uri_t description_uri;

    /** List of services that this device publish */
    t_upnp_service *services;

    /* upnp_device *embedded_devices; */

    /** ip address configured for the device */
    const char *ip_address;

    /** boot counter: incremented each time the device (re)joins the network, or is updated */
    long boot_id;

} t_upnp_device;

/**
 * Initialize the UPnP system:
 *
 *   - Discovery: SSDP discovery protocol (HTTPU - multicast and unicast over UDP message(s))
 *   - Description/Control/Eventing/Presentation: HTTP/SOAP for device(s) message(s) transport
 *
 * @param net_addr network address on which the uPnP will publish their services.
 *   The uPnP arquitecture requires that the ip address of the network has to be assigned from
 *   a DHCP server in the network (network is managed) or from automatic ip addressing (Auto-IP).
 *
 * @return 0 on success; !0 on error
 */
int init_upnp_system(struct net_addr* net_addr);

#endif //ESP_FIRMWARE_UPNP_H
```
